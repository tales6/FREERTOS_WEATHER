#include "oled.h"
#include "i2c.h"
#include <string.h>

static uint8_t oled_gram[128][8];

static void oled_wr_byte(uint8_t data, uint8_t cmd)
{
    uint8_t buf[2];
    buf[0] = cmd ? OLED_DATA : OLED_CMD;
    buf[1] = data;
    HAL_I2C_Master_Transmit(&hi2c1, OLED_I2C_ADDR, buf, 2, 100);
}

void oled_refresh_gram(void)
{
    uint8_t i, n;
    for (i = 0; i < 8; i++)
    {
        oled_wr_byte(0xb0 + i, OLED_CMD);
        oled_wr_byte(0x00, OLED_CMD);
        oled_wr_byte(0x10, OLED_CMD);
        for (n = 0; n < 128; n++)
        {
            oled_wr_byte(oled_gram[n][i], OLED_DATA);
        }
    }
}

void oled_init(void)
{
    HAL_Delay(100);

    oled_wr_byte(0xAE, OLED_CMD);
    oled_wr_byte(0xD5, OLED_CMD);
    oled_wr_byte(80, OLED_CMD);
    oled_wr_byte(0xA8, OLED_CMD);
    oled_wr_byte(0x3F, OLED_CMD);
    oled_wr_byte(0xD3, OLED_CMD);
    oled_wr_byte(0x00, OLED_CMD);
    oled_wr_byte(0x40, OLED_CMD);
    oled_wr_byte(0x8D, OLED_CMD);
    oled_wr_byte(0x14, OLED_CMD);
    oled_wr_byte(0x20, OLED_CMD);
    oled_wr_byte(0x02, OLED_CMD);
    oled_wr_byte(0xA1, OLED_CMD);
    oled_wr_byte(0xC8, OLED_CMD);
    oled_wr_byte(0xDA, OLED_CMD);
    oled_wr_byte(0x12, OLED_CMD);
    oled_wr_byte(0x81, OLED_CMD);
    oled_wr_byte(0xEF, OLED_CMD);
    oled_wr_byte(0xD9, OLED_CMD);
    oled_wr_byte(0xf1, OLED_CMD);
    oled_wr_byte(0xDB, OLED_CMD);
    oled_wr_byte(0x30, OLED_CMD);
    oled_wr_byte(0xA4, OLED_CMD);
    oled_wr_byte(0xA6, OLED_CMD);
    oled_wr_byte(0xAF, OLED_CMD);

    oled_clear();
}

void oled_clear_buffer(void)
{
    uint8_t i, n;
    for (i = 0; i < 8; i++)
        for (n = 0; n < 128; n++)
            oled_gram[n][i] = 0x00;
}

void oled_clear(void)
{
    oled_clear_buffer();
    oled_refresh_gram();
}

void oled_draw_point(uint8_t x, uint8_t y, uint8_t dot)
{
    uint8_t pos, bx, temp = 0;

    if (x > 127 || y > 63) return;

    pos = y / 8;
    bx = y % 8;
    temp = 1 << bx;

    if (dot)
    {
        oled_gram[x][pos] |= temp;
    }
    else
    {
        oled_gram[x][pos] &= ~temp;
    }
}

const unsigned char oled_asc2_1608[95][16]={
{0x00,0x00,0x00,0x00,0x00,0x00,0x00,0x00,0x00,0x00,0x00,0x00,0x00,0x00,0x00,0x00},
{0x00,0x00,0x00,0x00,0x00,0x00,0x1F,0xCC,0x00,0x0C,0x00,0x00,0x00,0x00,0x00,0x00},
{0x00,0x00,0x08,0x00,0x30,0x00,0x60,0x00,0x08,0x00,0x30,0x00,0x60,0x00,0x00,0x00},
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{0x00,0x00,0x60,0x00,0x80,0x00,0x80,0x00,0x40,0x00,0x40,0x00,0x20,0x00,0x20,0x00},
};

void oled_show_char(uint8_t x, uint8_t y, char c)
{
    uint8_t temp, t, t1;
    uint8_t y0 = y;
    uint8_t *pfont = 0;
    uint8_t csize = 16;

    if (c < ' ' || c > '~') return;

    uint8_t chr = c - ' ';

    pfont = (uint8_t *)oled_asc2_1608[chr];

    for (t = 0; t < csize; t++)
    {
        temp = pfont[t];

        for (t1 = 0; t1 < 8; t1++)
        {
            if (temp & 0x80) oled_draw_point(x, y, 1);
            else oled_draw_point(x, y, 0);

            temp <<= 1;
            y++;

            if ((y - y0) == 16)
            {
                y = y0;
                x++;
                break;
            }
        }
    }
}

void oled_show_string(uint8_t x, uint8_t y, const char *p)
{
    while ((*p <= '~') && (*p >= ' '))
    {
        if (x > (128 - 8))
        {
            x = 0;
            y += 16;
        }

        if (y > (64 - 16))
        {
            y = 0;
            x = 0;
        }

        oled_show_char(x, y, *p);
        x += 8;
        p++;
    }
}

void oled_show_big_char(uint8_t x, uint8_t y, char c)
{
    uint8_t temp, t, t1;
    uint8_t y0 = y;

    if (c < ' ' || c > '~') return;

    uint8_t *pfont = (uint8_t *)oled_asc2_1608[c - ' '];

    for (t = 0; t < 16; t++)
    {
        temp = pfont[t];
        for (t1 = 0; t1 < 8; t1++)
        {
            if (temp & 0x80)
            {
                oled_draw_point(x, y, 1);
                oled_draw_point(x + 1, y, 1);
                oled_draw_point(x, y + 1, 1);
                oled_draw_point(x + 1, y + 1, 1);
            }
            temp <<= 1;
            y += 2;
            if ((y - y0) == 32)
            {
                y = y0;
                x += 2;
                break;
            }
        }
    }
}

void oled_show_big_string(uint8_t x, uint8_t y, const char *p)
{
    while (*p)
    {
        if (*p < ' ' || *p > '~') { p++; continue; }
        if (x > (128 - 16))
        {
            x = 0;
            y += 32;
        }
        if (y > (64 - 32))
        {
            y = 0;
            x = 0;
        }
        oled_show_big_char(x, y, *p);
        x += 16;
        p++;
    }
}


